## projects/wifi-access-point/Config.in
```kconfig
config WIFI_ACCESS_POINT_SSID
    string "Wi-Fi network name (SSID)"
    default "somenet"
    help
      Wi-Fi network name as an ASCII string.

config WIFI_ACCESS_POINT_CHANNEL
    int "Channel number (IEEE 802.11)"
    default 36
    help
      0 is not supported.

config WIFI_ACCESS_POINT_PSK
    string "WPA preshared key"
    help
      This must be entered as a 256-bit secret in hex format
      (64 hex digits).

      WARNING! WARNING!
      The key appears as-is in the .config file, and may appear
      in the build log! Avoid using a valuable key if either
      the .config file or the build log may be distributed.
```

## projects/wifi-access-point/board/orangepi-zero-plus/package/rtl8189fs-custom/Config.in
```kconfig
config BR2_PACKAGE_RTL8189FS_CUSTOM
	bool "rtl8189fs-custom"
	depends on BR2_LINUX_KERNEL
	help
	  Wireless driver rtl8189fs.

	  https://github.com/jwrdegoede/rtl8189ES_linux.git

comment "rtl8189fs-custom needs a Linux kernel to be built"
	depends on !BR2_LINUX_KERNEL
```

## projects/wifi-access-point/configs/compex_wpj419_defconfig
```kconfig
BR2_arm=y
BR2_cortex_a7=y
BR2_ARM_FPU_VFPV4=y

BR2_TOOLCHAIN_BUILDROOT_CXX=y
BR2_SYSTEM_DHCP="eth0"

# Kernel
BR2_LINUX_KERNEL=y
BR2_LINUX_KERNEL_CUSTOM_VERSION=y
BR2_LINUX_KERNEL_CUSTOM_VERSION_VALUE="4.19.68"
BR2_LINUX_KERNEL_PATCH="$(BR2_EXTERNAL_WIFI_ACCESS_POINT_PATH)/board/compex-wpj419/patches-4.19"
BR2_LINUX_KERNEL_USE_CUSTOM_CONFIG=y
BR2_LINUX_KERNEL_CUSTOM_CONFIG_FILE="$(BR2_EXTERNAL_WIFI_ACCESS_POINT_PATH)/board/compex-wpj419/config-4.19"
BR2_LINUX_KERNEL_UIMAGE=y
BR2_LINUX_KERNEL_UIMAGE_LOADADDR="0x80208000"
BR2_LINUX_KERNEL_CONFIG_FRAGMENT_FILES="$(BR2_EXTERNAL_WIFI_ACCESS_POINT_PATH)/board/compex-wpj419/linux-extras.config"
BR2_LINUX_KERNEL_DTS_SUPPORT=y
BR2_LINUX_KERNEL_CUSTOM_DTS_PATH="$(BR2_EXTERNAL_WIFI_ACCESS_POINT_PATH)/board/compex-wpj419/qcom-ipq4019-wpj419.dts"
BR2_LINUX_KERNEL_NEEDS_HOST_OPENSSL=y

# Filesystem
BR2_ROOTFS_OVERLAY="$(BR2_EXTERNAL_WIFI_ACCESS_POINT_PATH)/board/compex-wpj419/rootfs_overlay $(BR2_EXTERNAL_WIFI_ACCESS_POINT_PATH)/rootfs_overlay"
BR2_ROOTFS_POST_IMAGE_SCRIPT="$(BR2_EXTERNAL_WIFI_ACCESS_POINT_PATH)/board/compex-wpj419/post-image.sh"
BR2_ROOTFS_POST_BUILD_SCRIPT="$(BR2_EXTERNAL_WIFI_ACCESS_POINT_PATH)/post-build.sh"
BR2_ROOTFS_POST_SCRIPT_ARGS="$(WIFI_ACCESS_POINT_SSID) $(WIFI_ACCESS_POINT_CHANNEL) $(WIFI_ACCESS_POINT_PSK)"
BR2_TARGET_ROOTFS_SQUASHFS=y
BR2_TARGET_ROOTFS_SQUASHFS4_ZSTD=y

# Host packages
BR2_PACKAGE_HOST_LINUX_HEADERS_CUSTOM_4_19=y
BR2_PACKAGE_HOST_DOSFSTOOLS=y
BR2_PACKAGE_HOST_E2FSPROGS=y
BR2_PACKAGE_HOST_GENIMAGE=y
BR2_PACKAGE_HOST_MTOOLS=y

# Target packages
BR2_PACKAGE_BUSYBOX_CONFIG="$(BR2_EXTERNAL_WIFI_ACCESS_POINT_PATH)/busybox.config"
BR2_PACKAGE_DROPBEAR=y
BR2_PACKAGE_DROPBEAR_DISABLE_REVERSEDNS=y
BR2_PACKAGE_HOSTAPD=y
BR2_PACKAGE_IPERF3=y
BR2_PACKAGE_IPTABLES=y
BR2_PACKAGE_IW=y
```

## projects/wifi-access-point/configs/orangepi_zero_plus_defconfig
```kconfig
BR2_aarch64=y
BR2_cortex_a53=y
BR2_ARM_FPU_VFPV4=y

BR2_PACKAGE_HOST_LINUX_HEADERS_CUSTOM_5_0=y
BR2_ROOTFS_DEVICE_CREATION_DYNAMIC_MDEV=y

# Firmware
BR2_TARGET_ARM_TRUSTED_FIRMWARE=y
BR2_TARGET_ARM_TRUSTED_FIRMWARE_CUSTOM_GIT=y
BR2_TARGET_ARM_TRUSTED_FIRMWARE_CUSTOM_REPO_URL="https://github.com/apritzel/arm-trusted-firmware.git"
BR2_TARGET_ARM_TRUSTED_FIRMWARE_PLATFORM="sun50iw1p1"
BR2_TARGET_ARM_TRUSTED_FIRMWARE_CUSTOM_REPO_VERSION="aa75c8da415158a94b82a430b2b40000778e851f"
BR2_TARGET_ARM_TRUSTED_FIRMWARE_BL31=y

# Bootloader
BR2_TARGET_UBOOT=y
BR2_TARGET_UBOOT_BUILD_SYSTEM_KCONFIG=y
BR2_TARGET_UBOOT_CUSTOM_VERSION=y
BR2_TARGET_UBOOT_CUSTOM_VERSION_VALUE="2019.01"
BR2_TARGET_UBOOT_BOARD_DEFCONFIG="orangepi_zero_plus"
BR2_TARGET_UBOOT_NEEDS_DTC=y
BR2_TARGET_UBOOT_NEEDS_PYLIBFDT=y
BR2_TARGET_UBOOT_NEEDS_ATF_BL31=y
BR2_TARGET_UBOOT_FORMAT_CUSTOM=y
BR2_TARGET_UBOOT_FORMAT_CUSTOM_NAME="u-boot.itb"
BR2_TARGET_UBOOT_SPL=y
BR2_TARGET_UBOOT_SPL_NAME="spl/sunxi-spl.bin"
BR2_TARGET_UBOOT_BOOT_SCRIPT=y
BR2_TARGET_UBOOT_BOOT_SCRIPT_SOURCE="$(BR2_EXTERNAL_WIFI_ACCESS_POINT_PATH)/board/orangepi-zero-plus/boot.cmd"

# Kernel
BR2_LINUX_KERNEL=y
BR2_LINUX_KERNEL_CUSTOM_VERSION=y
BR2_LINUX_KERNEL_CUSTOM_VERSION_VALUE="5.0"
BR2_LINUX_KERNEL_USE_ARCH_DEFAULT_CONFIG=y
BR2_LINUX_KERNEL_DTS_SUPPORT=y
BR2_LINUX_KERNEL_INTREE_DTS_NAME="allwinner/sun50i-h5-orangepi-zero-plus"
BR2_LINUX_KERNEL_NEEDS_HOST_OPENSSL=y

# Filesystem
BR2_TARGET_ROOTFS_EXT2=y
BR2_TARGET_ROOTFS_EXT2_4=y
BR2_ROOTFS_POST_IMAGE_SCRIPT="$(BR2_EXTERNAL_WIFI_ACCESS_POINT_PATH)/board/orangepi-zero-plus/post-image.sh"
BR2_ROOTFS_POST_BUILD_SCRIPT="$(BR2_EXTERNAL_WIFI_ACCESS_POINT_PATH)/post-build.sh"
BR2_ROOTFS_POST_SCRIPT_ARGS="$(WIFI_ACCESS_POINT_SSID) $(WIFI_ACCESS_POINT_CHANNEL) $(WIFI_ACCESS_POINT_PSK)"
BR2_ROOTFS_OVERLAY="$(BR2_EXTERNAL_WIFI_ACCESS_POINT_PATH)/board/orangepi-zero-plus/rootfs_overlay $(BR2_EXTERNAL_WIFI_ACCESS_POINT_PATH)/rootfs_overlay"

# Host packages
BR2_PACKAGE_HOST_DOSFSTOOLS=y
BR2_PACKAGE_HOST_GENIMAGE=y
BR2_PACKAGE_HOST_MTOOLS=y

# Target packages
BR2_PACKAGE_BUSYBOX_CONFIG="$(BR2_EXTERNAL_WIFI_ACCESS_POINT_PATH)/busybox.config"
BR2_PACKAGE_DROPBEAR=y
BR2_PACKAGE_DROPBEAR_DISABLE_REVERSEDNS=y
BR2_PACKAGE_HOSTAPD=y
BR2_PACKAGE_HOSTAPD_DRIVER_RTW=y
BR2_PACKAGE_IPERF3=y
BR2_PACKAGE_IPTABLES=y
BR2_PACKAGE_RTL8189FS_CUSTOM=y
BR2_PACKAGE_IW=y
```

## projects/wifi-access-point/configs/raspberrypi3_64_defconfig
```kconfig
BR2_aarch64=y
BR2_ARM_FPU_VFPV4=y

BR2_TOOLCHAIN_BUILDROOT_CXX=y
BR2_SYSTEM_DHCP="eth0"

# Firmware
BR2_PACKAGE_RPI_FIRMWARE=y
BR2_PACKAGE_RPI_WIFI_FIRMWARE=y

# Kernel
BR2_PACKAGE_HOST_LINUX_HEADERS_CUSTOM_4_19=y
BR2_LINUX_KERNEL=y
BR2_LINUX_KERNEL_CUSTOM_TARBALL=y
BR2_LINUX_KERNEL_CUSTOM_TARBALL_LOCATION="$(call github,raspberrypi,linux,5eeff139ea9135db6e01a58ef613338f1d0899d8)/linux-5eeff139ea9135db6e01a58ef613338f1d0899d8.tar.gz"
BR2_LINUX_KERNEL_DEFCONFIG="bcmrpi3"
BR2_LINUX_KERNEL_CONFIG_FRAGMENT_FILES="$(BR2_EXTERNAL_WIFI_ACCESS_POINT_PATH)/board/raspberrypi3-64/linux-extras.config"
BR2_LINUX_KERNEL_DTS_SUPPORT=y
BR2_LINUX_KERNEL_INTREE_DTS_NAME="broadcom/bcm2710-rpi-3-b broadcom/bcm2710-rpi-3-b-plus broadcom/bcm2837-rpi-3-b"
BR2_LINUX_KERNEL_NEEDS_HOST_OPENSSL=y

# Filesystem
BR2_ROOTFS_OVERLAY="$(BR2_EXTERNAL_WIFI_ACCESS_POINT_PATH)/board/raspberrypi3-64/rootfs_overlay $(BR2_EXTERNAL_WIFI_ACCESS_POINT_PATH)/rootfs_overlay"
BR2_ROOTFS_POST_BUILD_SCRIPT="board/raspberrypi3-64/post-build.sh $(BR2_EXTERNAL_WIFI_ACCESS_POINT_PATH)/post-build.sh"
BR2_ROOTFS_POST_IMAGE_SCRIPT="$(BR2_EXTERNAL_WIFI_ACCESS_POINT_PATH)/board/raspberrypi3-64/post-image.sh"
BR2_ROOTFS_POST_SCRIPT_ARGS="$(WIFI_ACCESS_POINT_SSID) $(WIFI_ACCESS_POINT_CHANNEL) $(WIFI_ACCESS_POINT_PSK)"
BR2_TARGET_ROOTFS_SQUASHFS=y
BR2_TARGET_ROOTFS_SQUASHFS4_ZSTD=y

# Host packages
BR2_PACKAGE_HOST_DOSFSTOOLS=y
BR2_PACKAGE_HOST_E2FSPROGS=y
BR2_PACKAGE_HOST_GENIMAGE=y
BR2_PACKAGE_HOST_MTOOLS=y

# Target packages
BR2_PACKAGE_BUSYBOX_CONFIG="$(BR2_EXTERNAL_WIFI_ACCESS_POINT_PATH)/busybox.config"
BR2_PACKAGE_DROPBEAR=y
BR2_PACKAGE_DROPBEAR_DISABLE_REVERSEDNS=y
BR2_PACKAGE_HOSTAPD=y
BR2_PACKAGE_IPERF3=y
BR2_PACKAGE_IPTABLES=y
BR2_PACKAGE_IW=y
```
